## drivers/Kconfig
```kconfig
menu "FMCU Drivers Configuration"
    config FM_USING_DEVICE_DRIVERS
        bool "Enable device drivers"
        default n

    if FM_USING_DEVICE_DRIVERS
        config FM_USING_SERIAL
            bool "Enable serial driver"
            default n
        
        if FM_USING_SERIAL
            config FM_SERIAL_USING_DMA
                bool "Enable serial DMA mode"
                default n
        endif

        config FM_USING_PIN
            bool "Enable pin driver"
            default n
        
        config FM_USING_ADC
            bool "Enable adc driver"
            default n
        
        config FM_USING_PWM
            bool "Enable pwm driver"
            default n

        config FM_USING_I2C
            bool "Using I2C device drivers"
            default n

        if FM_USING_I2C
            config FM_I2C_DEBUG
                bool "Use I2C debug message"
                default n

            config FM_USING_I2C_BITOPS
                bool "Use GPIO to simulate I2C"
                default y

            if FM_USING_I2C_BITOPS
                config FM_I2C_BITOPS_DEBUG
                    bool "Use simulate I2C debug message"
                    default n
            endif

            config FM_USING_SOFT_I2C
                bool "Use GPIO to soft simulate I2C"
                default n
                select FM_USING_PIN
                select FM_USING_I2C_BITOPS
            if FM_USING_SOFT_I2C
                config FM_USING_SOFT_I2C1
                    bool "Enable I2C1 Bus (software simulation)"
                    default y
                    if FM_USING_SOFT_I2C1
                        config FM_SOFT_I2C1_SCL_PIN
                            int "SCL pin number"
                            range 0 32767
                            default 1
                        config FM_SOFT_I2C1_SDA_PIN
                            int "SDA pin number"
                            range 0 32767
                            default 2
                        config FM_SOFT_I2C1_BUS_NAME
                            string "Bus name"
                            default i2c1
                        config FM_SOFT_I2C1_TIMING_DELAY
                            int "Timing delay (us)"
                            range 0 32767
                            default 10
                        config FM_SOFT_I2C1_TIMING_TIMEOUT
                            int "Timing timeout (tick)"
                            range 0 32767
                            default 10
                    endif
                config FM_USING_SOFT_I2C2
                    bool "Enable I2C2 Bus (software simulation)"
                    default n
                    if FM_USING_SOFT_I2C2
                        config FM_SOFT_I2C2_SCL_PIN
                            int "SCL pin number"
                            range 0 32767
                            default 3
                        config FM_SOFT_I2C2_SDA_PIN
                            int "SDA pin number"
                            range 0 32767
                            default 4
                        config FM_SOFT_I2C2_BUS_NAME
                            string "Bus name"
                            default i2c2
                        config FM_SOFT_I2C2_TIMING_DELAY
                            int "Timing delay (us)"
                            range 0 32767
                            default 10
                        config FM_SOFT_I2C2_TIMING_TIMEOUT
                            int "Timing timeout (tick)"
                            range 0 32767
                            default 10
                    endif
                config FM_USING_SOFT_I2C3
                    bool "Enable I2C3 Bus (software simulation)"
                    default n
                    if FM_USING_SOFT_I2C3
                        config FM_SOFT_I2C3_SCL_PIN
                            int "SCL pin number"
                            range 0 32767
                            default 5
                        config FM_SOFT_I2C3_SDA_PIN
                            int "SDA pin number"
                            range 0 32767
                            default 6
                        config FM_SOFT_I2C3_BUS_NAME
                            string "Bus name"
                            default i2c3
                        config FM_SOFT_I2C3_TIMING_DELAY
                            int "Timing delay (us)"
                            range 0 32767
                            default 10
                        config FM_SOFT_I2C3_TIMING_TIMEOUT
                            int "Timing timeout (tick)"
                            range 0 32767
                            default 10
                    endif
                config FM_USING_SOFT_I2C4
                    bool "Enable I2C4 Bus (software simulation)"
                    default n
                    if FM_USING_SOFT_I2C4
                        config FM_SOFT_I2C4_SCL_PIN
                            int "SCL pin number"
                            range 0 32767
                            default 7
                        config FM_SOFT_I2C4_SDA_PIN
                            int "SDA pin number"
                            range 0 32767
                            default 8
                        config FM_SOFT_I2C4_BUS_NAME
                            string "Bus name"
                            default i2c4
                        config FM_SOFT_I2C4_TIMING_DELAY
                            int "Timing delay (us)"
                            range 0 32767
                            default 10
                        config FM_SOFT_I2C4_TIMING_TIMEOUT
                            int "Timing timeout (tick)"
                            range 0 32767
                            default 10
                    endif
                config FM_USING_SOFT_I2C5
                    bool "Enable I2C5 Bus (software simulation)"
                    default n
                    if FM_USING_SOFT_I2C5
                        config FM_SOFT_I2C5_SCL_PIN
                            int "SCL pin number"
                            range 0 32767
                            default 9
                        config FM_SOFT_I2C5_SDA_PIN
                            int "SDA pin number"
                            range 0 32767
                            default 10
                        config FM_SOFT_I2C5_BUS_NAME
                            string "Bus name"
                            default i2c5
                        config FM_SOFT_I2C5_TIMING_DELAY
                            int "Timing delay (us)"
                            range 0 32767
                            default 10
                        config FM_SOFT_I2C5_TIMING_TIMEOUT
                            int "Timing timeout (tick)"
                            range 0 32767
                            default 10
                    endif
                config FM_USING_SOFT_I2C6
                    bool "Enable I2C6 Bus (software simulation)"
                    default n
                    if FM_USING_SOFT_I2C6
                        config FM_SOFT_I2C6_SCL_PIN
                            int "SCL pin number"
                            range 0 32767
                            default 11
                        config FM_SOFT_I2C6_SDA_PIN
                            int "SDA pin number"
                            range 0 32767
                            default 12
                        config FM_SOFT_I2C6_BUS_NAME
                            string "Bus name"
                            default i2c6
                        config FM_SOFT_I2C6_TIMING_DELAY
                            int "Timing delay (us)"
                            range 0 32767
                            default 10
                        config FM_SOFT_I2C6_TIMING_TIMEOUT
                            int "Timing timeout (tick)"
                            range 0 32767
                            default 10
                    endif
                config FM_USING_SOFT_I2C7
                    bool "Enable I2C7 Bus (software simulation)"
                    default n
                    if FM_USING_SOFT_I2C7
                        config FM_SOFT_I2C7_SCL_PIN
                            int "SCL pin number"
                            range 0 32767
                            default 13
                        config FM_SOFT_I2C7_SDA_PIN
                            int "SDA pin number"
                            range 0 32767
                            default 14
                        config FM_SOFT_I2C7_BUS_NAME
                            string "Bus name"
                            default i2c7
                        config FM_SOFT_I2C7_TIMING_DELAY
                            int "Timing delay (us)"
                            range 0 32767
                            default 10
                        config FM_SOFT_I2C7_TIMING_TIMEOUT
                            int "Timing timeout (tick)"
                            range 0 32767
                            default 10
                    endif
                config FM_USING_SOFT_I2C8
                    bool "Enable I2C8 Bus (software simulation)"
                    default n
                    if FM_USING_SOFT_I2C8
                        config FM_SOFT_I2C8_SCL_PIN
                            int "SCL pin number"
                            range 0 32767
                            default 15
                        config FM_SOFT_I2C8_SDA_PIN
                            int "SDA pin number"
                            range 0 32767
                            default 16
                        config FM_SOFT_I2C8_BUS_NAME
                            string "Bus name"
                            default i2c8
                        config FM_SOFT_I2C8_TIMING_DELAY
                            int "Timing delay (us)"
                            range 0 32767
                            default 10
                        config FM_SOFT_I2C8_TIMING_TIMEOUT
                            int "Timing timeout (tick)"
                            range 0 32767
                            default 10
                    endif
            endif
        endif

        config FM_USING_HWTIMER
            bool "Using hardware timer device drivers"
            default n
    endif
endmenu
```

## examples/Kconfig
```kconfig
menu "QKit Examples Configuration"
    config EXAMPLES_ENABLE
        bool "Enable examples"
        default n

    if EXAMPLES_ENABLE
        config EXAMPLE_TIMER_ENABLE
            bool "Enable timer example"
            default n
    
        config EXAMPLE_MEMH_ENABLE
            bool "Enable memh example"
            default n
    endif
endmenu
```

## src/Kconfig
```kconfig
menu "FMCU Kernel Configuration"

config FM_NAME_MAX
    int "The maximal size of kernel name"
    range 1 64
    default 16

config FM_TICK_PER_SECOND
    int "Tick frequency, Hz"
    range 10 1000
    default 1000

config FM_USING_COMPONENTS_INIT
    bool "Using components init"
    default n

config FM_ALIGN_SIZE
    int "Alignment size for CPU architecture data access"
    default 8
    help

menuconfig FM_USING_DEBUG
    bool "Enable debugging features"
    default y

    if FM_USING_DEBUG
        config FM_DEBUGING_COLOR
            bool "Enable color debugging log"
            default y

        config FM_DEBUGING_INIT
            bool "Enable debugging of components initialization"
            default n
    endif

menu "Memory Management"

    menuconfig FM_USING_MEMHEAP
        bool "Using memheap Memory Algorithm"
        default n

        if FM_USING_MEMHEAP
            choice
                prompt "Memheap memory allocation mode"
                default FM_MEMHEAP_FAST_MODE

                config FM_MEMHEAP_FAST_MODE
                    bool "fast mode"
                    help
                        Speed priority mode.
                        As long as the memory block size meets the requirements, the search ends immediately.

                config FM_MEMHEAP_BEST_MODE
                    bool "best mode"
                    help
                        Best size first.
                        The search does not end until the memory block of the most appropriate size is found
            endchoice
        endif

    choice
        prompt "System Heap Memory Management"
        default FM_USING_MEMHEAP_AS_HEAP

        config FM_USING_MEMHEAP_AS_HEAP
            bool "Use memheap objects as heap"
            select FM_USING_MEMHEAP

        config FM_USING_NOHEAP
            bool "Disable Heap"
    endchoice

    config FM_USING_HEAP
        bool
        default n if FM_USING_NOHEAP
        default y if FM_USING_MEMHEAP_AS_HEAP
endmenu

menu "Kernel Device Object"

    config FM_USING_DEVICE
        bool "Using device object"
        default y

    config FM_USING_DEVICE_OPS
        bool "Using ops for each device object"
        default n

    config FM_USING_CONSOLE
        bool "Using console for rt_kprintf"
        default y

    if FM_USING_CONSOLE
        config FM_CONSOLEBUF_SIZE
            int "the buffer size for console log printf"
            default 256

        config FM_CONSOLE_DEVICE_NAME
            string "the device name for console"
            default "uart"
    endif

endmenu

endmenu
```
