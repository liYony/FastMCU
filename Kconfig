## Kconfig
```kconfig
source "$FM_ROOT_DIR/src/Kconfig"
source "$FM_ROOT_DIR/drivers/Kconfig"
source "$FM_ROOT_DIR/components/Kconfig"
```

## bsp/hc32/hc32f4a0pi/Kconfig
```kconfig
mainmenu "FMCU Configuration"

config FM_ROOT_DIR
    string
    option env="FM_ROOT_DIR"
    default "../../.."

source "$FM_ROOT_DIR/Kconfig"
source "board/Kconfig"
```

## bsp/hc32/hc32f4a0pi/board/Kconfig
```kconfig
menu "Hardware Drivers Config"

config SOC_HC32F4A0PI
    bool
    select SOC_SERIES_HC32F4
    select FM_USING_COMPONENTS_INIT
    default y

menu "Onboard Peripheral Drivers"

    

endmenu

menu "On-chip Peripheral Drivers"

    config BSP_USING_GPIO
        bool "Enable GPIO"
        select FM_USING_PIN
        default y

    menuconfig BSP_USING_UART
        bool "Enable UART"
        default y
        select FM_USING_SERIAL
        if BSP_USING_UART
            menuconfig BSP_USING_UART3
                bool "Enable UART3"
                default y
                if BSP_USING_UART3
                    config BSP_UART3_RX_USING_DMA
                        bool "Enable UART3 RX DMA"
                        select FM_SERIAL_USING_DMA
                        default n

                    config BSP_UART3_TX_USING_DMA
                        bool "Enable UART3 TX DMA"
                        select FM_SERIAL_USING_DMA
                        default n

                    config BSP_UART3_RX_BUFSIZE
                        int "Set UART3 RX buffer size"
                        range 64 65535
                        default 256

                    config BSP_UART3_TX_BUFSIZE
                        int "Set UART3 TX buffer size"
                        range 0 65535
                        default 0
                endif
        endif

    menuconfig BSP_USING_ADC
        bool "Enable ADC"
        default n
        select FM_USING_ADC
        if BSP_USING_ADC
            config BSP_USING_ADC1
                bool "Enable ADC1"
                default n
        endif
    
    menuconfig BSP_USING_TIM_TMRA
        bool "Enable timerA"
        default n
        select FM_USING_HWTIMER
        if BSP_USING_TIM_TMRA
            config BSP_USING_TIM_TMRA_1
                bool "Enable timerA-1"
                default n
        endif

    menuconfig BSP_USING_PWM_TMRA
        bool "Enable timerA output PWM"
        default n
        select FM_USING_PWM
        if BSP_USING_PWM_TMRA
        menuconfig BSP_USING_PWM_TMRA_2
            bool "Enable timerA-2 output PWM"
            default n
            if BSP_USING_PWM_TMRA_2
                config BSP_USING_PWM_TMRA_2_CH4
                    bool "Enable timerA-2 channel4"
                    default n
            endif

        menuconfig BSP_USING_PWM_TMRA_10
            bool "Enable timerA-10 output PWM"
            default n
            if BSP_USING_PWM_TMRA_10
                config BSP_USING_PWM_TMRA_10_CH1
                    bool "Enable timerA-10 channel1"
                    default n
            endif
            if BSP_USING_PWM_TMRA_10
                config BSP_USING_PWM_TMRA_10_CH2
                    bool "Enable timerA-10 channel2"
                    default n
            endif
        endif
endmenu

menu "Board extended module Drivers"

endmenu

endmenu
```

## bsp/hc32/libraries/Kconfig
```kconfig
config SOC_FAMILY_HC32
    bool

config SOC_SERIES_HC32F1
    bool
    select SOC_FAMILY_HC32

config SOC_SERIES_HC32F4
    bool
    select SOC_FAMILY_HC32

config SOC_SERIES_HC32M1
    bool
    select SOC_FAMILY_HC32

config SOC_SERIES_HC32M4
    bool
    select SOC_FAMILY_HC32
```

## bsp/stm32/libraries/Kconfig
```kconfig
config SOC_FAMILY_STM32
    bool

config SOC_SERIES_STM32F0
    bool
    select SOC_FAMILY_STM32

config SOC_SERIES_STM32F1
    bool
    select SOC_FAMILY_STM32

config SOC_SERIES_STM32F2
    bool
    select SOC_FAMILY_STM32

config SOC_SERIES_STM32F3
    bool
    select SOC_FAMILY_STM32

config SOC_SERIES_STM32F4
    bool
    select SOC_FAMILY_STM32

config SOC_SERIES_STM32F7
    bool
    select SOC_FAMILY_STM32

config SOC_SERIES_STM32L0
    bool
    select SOC_FAMILY_STM32

config SOC_SERIES_STM32L1
    bool
    select SOC_FAMILY_STM32

config SOC_SERIES_STM32L4
    bool
    select SOC_FAMILY_STM32

config SOC_SERIES_STM32L5
    bool
    select SOC_FAMILY_STM32

config SOC_SERIES_STM32G0
    bool
    select SOC_FAMILY_STM32

config SOC_SERIES_STM32G4
    bool
    select SOC_FAMILY_STM32

config SOC_SERIES_STM32H7
    bool
    select SOC_FAMILY_STM32

config SOC_SERIES_STM32U5
    bool
    select SOC_FAMILY_STM32

config SOC_SERIES_STM32H5
    bool
    select SOC_FAMILY_STM32

config SOC_SERIES_STM32MP1
    bool
    select SOC_FAMILY_STM32

config SOC_SERIES_STM32WL
    bool
    select SOC_FAMILY_STM32

config SOC_SERIES_STM32WB
    bool
    select SOC_FAMILY_STM32
```

## bsp/stm32/stm32f407zg/Kconfig
```kconfig
mainmenu "FastMCU Configuration"

config BSP_ROOT_DIR
    string
    option env="BSP_ROOT_DIR"
    default "."

config FM_ROOT_DIR
    string
    option env="FM_ROOT_DIR"
    default "../../.."

config SOC_STM32F407ZG
    bool
    select SOC_SERIES_STM32F4
    select FM_USING_COMPONENTS_INIT
    default y

config BOARD_STM32F407_SPARK
    bool
    default y

source "$FM_ROOT_DIR/Kconfig"
source "../libraries/Kconfig"
source "board/Kconfig"
```

## bsp/stm32/stm32f407zg/board/Kconfig
```kconfig
menu "Hardware Drivers Config"

menu "Onboard Peripheral Drivers"

endmenu

menu "On-chip Peripheral Drivers"

    config BSP_USING_GPIO
        bool "Enable GPIO"
        select FM_USING_PIN
        default y

    menuconfig BSP_USING_UART
        bool "Enable UART"
        default y
        select FM_USING_SERIAL
        if BSP_USING_UART
            menuconfig BSP_USING_UART1
                bool "Enable UART1"
                default y
                if BSP_USING_UART1
                    config BSP_UART1_RX_USING_DMA
                        bool "Enable UART1 RX DMA"
                        select FM_SERIAL_USING_DMA
                        default n

                    config BSP_UART1_TX_USING_DMA
                        bool "Enable UART1 TX DMA"
                        select FM_SERIAL_USING_DMA
                        default n

                    config BSP_UART1_RX_BUFSIZE
                        int "Set UART1 RX buffer size"
                        range 64 65535
                        default 256

                    config BSP_UART1_TX_BUFSIZE
                        int "Set UART1 TX buffer size"
                        range 0 65535
                        default 0
                endif
        endif

    menuconfig BSP_USING_ADC
        bool "Enable ADC"
        default n
        select FM_USING_ADC
        if BSP_USING_ADC
            config BSP_USING_ADC1
                bool "Enable ADC1"
                default n
        endif
    
    
endmenu

menu "Board extended module Drivers"

endmenu

endmenu
```

## components/Kconfig
```kconfig
menu "FMCU Components Configuration"

source "$FM_ROOT_DIR/components/nr_micro_shell/Kconfig"
source "$FM_ROOT_DIR/components/network/Kconfig"

endmenu
```

## components/libc/Kconfig
```kconfig
menu "C/C++ and POSIX layer"

config FM_USING_EXTERNAL_LIBC
    bool
    help
        This is for external libc(e.g. mlib),
        and NOT for newlib or picolibc which are inherent in the toolchains.
        Usually, the external libc should be a software package and select
        FM_USING_EXTERNAL_LIBC in software package's Kconfig
        This option is not available for users to select.

endmenu
```

## components/network/lwip/Kconfig
```kconfig
menuconfig NET_LWIP_ENABLE
    bool "Enable lwip"
    default n
    if NET_LWIP_ENABLE
        config FM_LWIP_IPADDR
            string "IPv4: IP address"
            default 192.168.1.30

        config FM_LWIP_GWADDR
            string "IPv4: Gateway address"
            default 192.168.1.1

        config FM_LWIP_MSKADDR
            string "IPv4: Mask address"
            default 255.255.255.0
    endif
```

## components/sfud/Kconfig
```kconfig
menuconfig SFUD_ENABLE
    bool "Enable sfud"
    default n
    if SFUD_ENABLE
        config SFUD_DEBUG_MODE 
            bool "Enable debug mode"
            default n

        config SFUD_USING_SFDP 
            bool "Enable sfdp"
            default n

        config SFUD_USING_FLASH_INFO_TABLE 
            bool "Enable flash info table"
            default n

        config SFUD_USING_QSPI
            bool "Enable QSPI read"
            default n
    endif
```
